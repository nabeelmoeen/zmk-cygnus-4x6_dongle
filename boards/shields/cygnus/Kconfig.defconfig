## boards/shields/cygnus/Kconfig.defconfig
```kconfig
if SHIELD_CYGNUS_DONGLE

config ZMK_KEYBOARD_NAME
    default "Cygnus"

config ZMK_SPLIT_ROLE_CENTRAL
    default y

endif

if SHIELD_CYGNUS_DONGLE || SHIELD_CYGNUS_LEFT || SHIELD_CYGNUS_RIGHT

config ZMK_SPLIT
    default y
endif

CONFIG_ZMK_USB_BOOT=y
CONFIG_ZMK_SPLIT_BLE_CENTRAL_BATTERY_LEVEL_PROXY=y
CONFIG_ZMK_SPLIT_BLE_CENTRAL_BATTERY_LEVEL_FETCHING=y

config ZMK_SPLIT_BLE_CENTRAL_PERIPHERALS
    default 2

if ZMK_DISPLAY

config I2C
    default y

config SSD1306
    default y

choice ZMK_DISPLAY_WORK_QUEUE
    default ZMK_DISPLAY_WORK_QUEUE_DEDICATED
endchoice

endif

#
```
